## config/boards/shields/cool640tb/Kconfig.defconfig
```kconfig
if SHIELD_COOL640TB_R

config ZMK_KEYBOARD_NAME
    default "cool640tb_R"

config ZMK_SPLIT
    default y

config ZMK_SPLIT_ROLE_CENTRAL
    default y

endif

if SHIELD_COOL640TB_L

config ZMK_KEYBOARD_NAME
    default "cool640tb_L"

config ZMK_SPLIT
    default y

endif
```

## config/boards/shields/cool640tb/Kconfig.shield
```kconfig
config SHIELD_COOL640TB_R
    def_bool $(shields_list_contains,cool640tb_R)

config SHIELD_MONA_L
    def_bool $(shields_list_contains,cool640tb_L)
```

## config/boards/shields/moNa/Kconfig.defconfig
```kconfig
if SHIELD_MONA_L

config ZMK_KEYBOARD_NAME
    default "moNa_L"

config ZMK_SPLIT
    default y

config ZMK_SPLIT_ROLE_CENTRAL
    default y

endif

if SHIELD_MONA_R

config ZMK_KEYBOARD_NAME
    default "moNa_R"

config ZMK_SPLIT
    default y

endif
```

## config/boards/shields/moNa/Kconfig.shield
```kconfig
config SHIELD_MONA_R
    def_bool $(shields_list_contains,moNa_R)

config SHIELD_MONA_L
    def_bool $(shields_list_contains,moNa_L)
```

## config/west.yml
```yaml
manifest:
  remotes:
    - name: zmkfirmware
      url-base: https://github.com/zmkfirmware
    - name: telzo2000
      url-base: https://github.com/telzo2000
    # Additional modules containing boards/shields/custom code can be listed here as well
    # See https://docs.zephyrproject.org/3.2.0/develop/west/manifest.html#projects
  projects:
    - name: zmk
      remote: zmkfirmware
      revision: main
      import: app/west.yml
    - name: zmk-pmw3610-driver
      remote: telzo2000
      revision: main
  self:
    path: config
```
