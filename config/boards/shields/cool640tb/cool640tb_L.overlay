#include "cool640tb.dtsi"

&default_transform {
    col-offset = <5>;
};

&kscan0 {
        col-gpios
            = <&xiao_d 10 GPIO_ACTIVE_HIGH> // 6
            , <&xiao_d 9 GPIO_ACTIVE_HIGH>  // 5
            , <&xiao_d 8 GPIO_ACTIVE_HIGH>  // 4
            , <&xiao_d 7 GPIO_ACTIVE_HIGH>  // 3
            , <&gpio0 10 GPIO_ACTIVE_HIGH>  // 2
            , <&gpio0 9 GPIO_ACTIVE_HIGH>   // 1
            ;
};

&left_encoder {
    status = "okay";
};
