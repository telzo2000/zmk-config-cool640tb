#include "moNa.dtsi"

&default_transform {
    col-offset = <5>;
};

&kscan0 {
        col-gpios
            = <&gpio0 9 GPIO_ACTIVE_HIGH>   // 順番を逆に
            , <&gpio0 10 GPIO_ACTIVE_HIGH>
            , <&xiao_d 7 GPIO_ACTIVE_HIGH>  
            , <&xiao_d 8 GPIO_ACTIVE_HIGH> 
            , <&xiao_d 9 GPIO_ACTIVE_HIGH> 
            , <&xiao_d 10 GPIO_ACTIVE_HIGH>
            ;
};

&right_encoder {
    status = "okay";
};